## drivers/switch/Kconfig
```kconfig
menuconfig SWITCH
	tristate "Switch class support"
	help
	  Say Y here to enable switch class support. This allows
	  monitoring switches by userspace via sysfs and uevent.

if SWITCH

config SWITCH_GPIO
	tristate "GPIO Swith support"
	depends on GPIOLIB
	help
	  Say Y here to enable GPIO based switch support.

config SWITCH_H2W
	tristate "H2W Headset detection driver"
	default n
	help
	  Say Y here to enable h2w switch support.

endif # SWITCH
```
